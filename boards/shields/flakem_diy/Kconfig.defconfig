## boards/shields/flakem_diy/Kconfig.defconfig
```kconfig
if SHIELD_FLAKEM_DIY_LEFT

config ZMK_KEYBOARD_NAME
    default "FlakeM DIY"

config ZMK_SPLIT_ROLE_CENTRAL
    default y

endif # SHIELD_FLAKEM_DIY_LEFT

if SHIELD_FLAKEM_DIY_LEFT || SHIELD_FLAKEM_DIY_RIGHT

config ZMK_SPLIT
    default y

endif # SHIELD_FLAKEM_DIY_LEFT || SHIELD_FLAKEM_DIY_RIGHT
```

## boards/shields/flakem_diy/Kconfig.shield
```kconfig
config SHIELD_FLAKEM_DIY_LEFT
    def_bool $(shields_list_contains,flakem_diy_left)

config SHIELD_FLAKEM_DIY_RIGHT
    def_bool $(shields_list_contains,flakem_diy_right)
```
